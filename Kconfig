## Kconfig
```kconfig
# 这个文件定义了一些配置选项

# 顶层菜单
# menu "Fly Configuration"

# endmenu
mainmenu "Fly Configuration"
    source "arch/Kconfig"
    source "project/Kconfig"
    source "package/Kconfig"
```

## arch/Kconfig
```kconfig
choice
    prompt "Select CPU Architecture"
    default ARCH_MCXN947 

    config ARCH_MCXN947
        bool "mcxn947"
        help
            Select this option if you are targeting mcxn947 architecture.

    config ARCH_GD32F10X
        bool "gd32f10x"
        help
            Select this option if you are targeting gd32f10x architecture.

    config ARCH_GD32E23X
        bool "gd32e23x"
        help
            Select this option if you are targeting gd32e23x architecture.
    
    config ARCH_GD32VF103X
        bool "gd32vf103x"
        help
            Select this option if you are targeting gd32vf103x architecture.

    config ARCH_STM32F0XX
        bool "stm32f0xx"
        help
            Select this option if you are targeting stm32f0xx architecture.
    
    config ARCH_STM32F1XX
        bool "stm32f1xx"
        help
            Select this option if you are targeting stm32f1xx architecture.
    
    config ARCH_STM32F4XX
        bool "stm32f4xx"
        help
            Select this option if you are targeting stm32f4xx architecture.
    
    config ARCH_STM32H7XX
        bool "stm32h7xx"
        help
            Select this option if you are targeting stm32h7xx architecture.
    
    config ARCH_CH58X
        bool "ch58x"
        help
            Select this option if you are targeting ch58x architecture.
    

endchoice

config ARCH
    string
    default "mcxn947"                   if ARCH_MCXN947
    default "gd32/arm/gd32f10x"         if ARCH_GD32F10X
    default "gd32/arm/gd32e23x"         if ARCH_GD32E23X
    default "gd32/risc-v/gd32vf103"     if ARCH_GD32VF103X
    default "stm32/stm32f0xx"           if ARCH_STM32F0XX
    default "stm32/stm32f1xx"           if ARCH_STM32F1XX
    default "stm32/stm32f4xx"           if ARCH_STM32F4XX
    default "stm32/stm32h7xx"           if ARCH_STM32H7XX
    default "ch58x"                     if ARCH_CH58X
    
```

## package/argparse/Kconfig
```kconfig
config PACKAGE_ARGUMENT_PARSER
        bool "argument parser support"
    help
        Enable support for the argument parser.
        Selecting this option will add support for the argument parser to the system. 
    select PACKAGE_EVENTHUB_OS
```

## package/ehip-tools/Kconfig
```kconfig
menuconfig PACKAGE_EHIP_TOOLS
    bool "EHIP Tools Configuration"
    help
      Enable support for the ehip tools.
      Selecting this option makes subcommands available.
    depends on PACKAGE_EVENTHUB_OS
    depends on PACKAGE_EHIP
    depends on PACKAGE_EHSHELL
    select PACKAGE_ARGUMENT_PARSER

if PACKAGE_EHIP_TOOLS

config PACKAGE_EHIP_TOOLS_PING
    bool "Enable ping command"
    default n
    help
      Enable the ping command in the ehip tool.

config PACKAGE_EHIP_TOOLS_NSLOOKUP
    bool "Enable nslookup command"
    default n
    help
      Enable the nslookup command in the ehip tool.

config PACKAGE_EHIP_TOOLS_TELNET
    bool "Enable telnet command"
    default n
    help
      Enable the telnet command in the ehip tool.

config PACKAGE_EHIP_TOOLS_IFCONFIG
    bool "Enable ifconfig command"
    default n
    help
      Enable the ifconfig command in the ehip tool.

config PACKAGE_EHIP_TOOLS_ROUTE
    bool "Enable route command"
    default n
    help
      Enable the route command in the ehip tool.

config PACKAGE_EHIP_TOOLS_UDP_ECHO
    bool "Enable udp echo command"
    default n
    help
      Enable the udp echo command in the ehip tool.

config PACKAGE_EHIP_TOOLS_TCP_ECHO
    bool "Enable tcp echo command"
    default n
    help
      Enable the tcp echo server command in the ehip tool.

endif
```

## package/ehip/Kconfig
```kconfig
config PACKAGE_EHIP
        bool "Network protocol stack support"
    help
        Enable support for the network protocol stack.
        Selecting this option will add support for specific network protocols to the system. 
        This is important for applications that require networking capabilities. 
        If networking is not needed, disabling this option can reduce the size of the program and decrease boot time.
    depends on PACKAGE_EVENTHUB_OS
    select PACKAGE_EVENTHUB_GLOBAL_TIMER_SIGNAL
    select PACKAGE_EVENTHUB_GLOBAL_TIMER_SIGNAL_1S
    select PACKAGE_EVENTHUB_GLOBAL_TIMER_SIGNAL_500MS
    select PACKAGE_EVENTHUB_GLOBAL_TIMER_SIGNAL_100MS
```

## package/ehshell/Kconfig
```kconfig
menuconfig PACKAGE_EHSHELL
        bool "ehshell support"
    help
        Enable support for the ehshell.
        Selecting this option will add support for the ehshell to the system. 
        This is important for applications that require the ehshell. 
        If ehshell is not needed, disabling this option can reduce the size of the program and decrease boot time.
    depends on PACKAGE_EVENTHUB_OS

if PACKAGE_EHSHELL
    
config PACKAGE_EHSHELL_PASSWORD
    string "Password for shell access"
    default "ehshell"
    help
        The password required to access the shell.
        If not set, the shell will not require a password.

config PACKAGE_EHSHELL_USE_PASSWORD
    bool
    default y if PACKAGE_EHSHELL_PASSWORD != ""
    default n

# 终端空闲后多长时间需要重新输入密码
config PACKAGE_EHSHELL_PASSWORD_TIMEOUT
    int "Password timeout in seconds"
    default 600
    help
        The timeout for password input in seconds.
        If not set, the password will not timeout.
    depends on PACKAGE_EHSHELL_USE_PASSWORD

config PACKAGE_EHSHELL_MAX_COMMAND_SIZE
    int "Max number of commands"
    default 24
    help
        The max number of commands that can be registered.
        If not set, the default value is 24.

config PACKAGE_EHSHELL_MAX_BACKGROUND_COMMAND_SIZE
    int "Max number of background commands"
    default 4
    help
        The max number of background commands that can be run.
        If not set, the default value is 4.

menuconfig PACKAGE_EHSHELL_BUILTIN_SEGGER_RTT
    bool "Segger RTT shell"
    help
        Register the default shell as Segger RTT.
        Users can use Segger RTT to interact with the system.
    depends on PACKAGE_EHSHELL
    depends on PACKAGE_SEGGER_RTT

if PACKAGE_EHSHELL_BUILTIN_SEGGER_RTT

config PACKAGE_EHSHELL_BUILTIN_SEGGER_RTT_UP_CHANNEL_NUMBER
    int "Segger RTT upload channel number"
    default 0
    help
        The channel number for Segger RTT upload.

config PACKAGE_EHSHELL_BUILTIN_SEGGER_RTT_DOWN_CHANNEL_NUMBER
    int "Segger RTT download channel number"
    default 0
    help
        The channel number for Segger RTT download.

config PACKAGE_EHSHELL_BUILTIN_SEGGER_RTT_SHELL_LINE_BUFFER_SIZE
    int "Segger RTT shell line buffer size"
    default 64
    help
        The buffer size for shell line.

config PACKAGE_EHSHELL_BUILTIN_SEGGER_RTT_SHELL_INPUT_BUFFER_SIZE
    int "Segger RTT shell input buffer size"
    default 256
    help
        The max size for shell input.

endif


menuconfig PACKAGE_EHSHELL_BUILTIN_TELNET_SERVER
    bool "Telnet server shell"
    help
        Register the default shell as Telnet Server.
        Users can use Telnet Server to interact with the system.
    depends on PACKAGE_EHSHELL
    depends on PACKAGE_EHIP


if PACKAGE_EHSHELL_BUILTIN_TELNET_SERVER

config PACKAGE_EHSHELL_BUILTIN_TELNET_SERVER_SHELL_LINE_BUFFER_SIZE
    int "Telnet Server shell line buffer size"
    default 64
    help
        The buffer size for shell line.

config PACKAGE_EHSHELL_BUILTIN_TELNET_SERVER_SHELL_INPUT_BUFFER_SIZE
    int "Telnet Server shell input buffer size"
    default 256
    help
        The max size for shell input.

config PACKAGE_EHSHELL_BUILTIN_TELNET_SERVER_SHELL_MAX_CONNECTIONS
    int "Telnet Server shell max connections"
    default 4
    help
        The max number of connections for Telnet Server.

config PACKAGE_EHSHELL_BUILTIN_TELNET_SERVER_SHELL_PORT
    int "Telnet Server shell port"
    default 23
    help
        The port number for Telnet Server.

config PACKAGE_EHSHELL_BUILTIN_TELNET_SERVER_SHELL_TCP_ALIVE
    int "Telnet Server shell TCP alive timeout"
    default 10
    help
        The timeout for Telnet Server shell connection in seconds.

endif




endif #PACKAGE_EHSHELL
```

## package/eventhub-os/Kconfig
```kconfig
menuconfig PACKAGE_EVENTHUB_OS
        bool "eventhub os kernel support"
    help
        "eventhub os kernel support"

if PACKAGE_EVENTHUB_OS

menuconfig PACKAGE_EVENTHUB_GLOBAL_TIMER_SIGNAL
    bool "eventhub global timer signal"
    default n
if PACKAGE_EVENTHUB_GLOBAL_TIMER_SIGNAL

config PACKAGE_EVENTHUB_GLOBAL_TIMER_SIGNAL_1S
    bool "eventhub global timer signal 1s"
    default n

config PACKAGE_EVENTHUB_GLOBAL_TIMER_SIGNAL_500MS
    bool "eventhub global timer signal 500ms"
    default n

config PACKAGE_EVENTHUB_GLOBAL_TIMER_SIGNAL_100MS
    bool "eventhub global timer signal 100ms"
    default n

endif # PACKAGE_EVENTHUB_GLOBAL_TIMER_SIGNAL


endif # PACKAGE_EVENTHUB_OS
```

## package/factory-data/Kconfig
```kconfig
config FACTORY_DATA_SUPPORTED
    bool "Factory Data Support"
    default y
    help
        This option enables support for accessing factory data in the MCU firmware.

        Factory data is embedded at the end of the binary file and contains important information such as:
        - Software version
        - Partition name
        - Firmware name
        - Generation description (e.g., git hash, build date)

        Enabling this option will:
        - Allow the program to detect and read factory data from the firmware.
        - Provide a structured way to access and use the factory data.

        If you do not need access to factory data, you can disable this option.
```

## package/segger-rtt/Kconfig
```kconfig
config PACKAGE_SEGGER_RTT
        bool "SEGGER RTT Supported"
    help
        "SEGGER RTT Supported"
```

## project/Kconfig
```kconfig
rsource "mcxn947/Kconfig"
rsource "gd32f10x/Kconfig"
rsource "gd32e23x/Kconfig"
rsource "gd32vf103x/Kconfig"
rsource "stm32f0xx/Kconfig"
rsource "stm32f1xx/Kconfig"
rsource "stm32f4xx/Kconfig"
rsource "stm32h7xx/Kconfig"
rsource "ch58x/Kconfig"
rsource "linux/Kconfig"
```

## project/common/Kconfig
```kconfig
choice
    prompt "Select a common platform project"
    default PROJECT_COMMON_NONE 


config PROJECT_COMMON_NONE
    bool "None"
    help
      Select this if you do not want to set any project.

config PROJECT_COMMON_DEMO
    bool "COMMON demo project"
    select  COMMON_PROJECT_SET
    help
        Select this option to enable Module COMMON DEMO.

endchoice

if COMMON_PROJECT_SET
config PROJECT
    string
    default "common-demo" if PROJECT_COMMON_DEMO
endif
```

## project/linux/ehip-test/defconfig
```kconfig
CONFIG_ARCH_X64_LINUX=y
CONFIG_PROJECT_EHIP_TEST=y
CONFIG_PACKAGE_EHIP_TOOLS=y
CONFIG_PACKAGE_EHIP_TOOLS_PING=y
# CONFIG_FACTORY_DATA_SUPPORTED is not set
```

## project/macos/ehip-test/defconfig
```kconfig
CONFIG_ARCH_ARM64_MACOS=y
CONFIG_PROJECT_MACOS_EHIP_TEST=y
CONFIG_PACKAGE_EHIP_TOOLS=y
CONFIG_PACKAGE_EHIP_TOOLS_PING=y
CONFIG_PACKAGE_EHIP_TOOLS_NSLOOKUP=y
# CONFIG_FACTORY_DATA_SUPPORTED is not set
```

## project/mcxn947/mcxn947-eth-demo/defconfig
```kconfig
CONFIG_PROJECT_MCXN947_ETH_DEMO=y
CONFIG_PACKAGE_EHIP_TOOLS=y
CONFIG_PACKAGE_EHIP_TOOLS_PING=y
CONFIG_PACKAGE_EHIP_TOOLS_NSLOOKUP=y
CONFIG_PACKAGE_EHIP_TOOLS_TELNET=y
CONFIG_PACKAGE_EHIP_TOOLS_IFCONFIG=y
CONFIG_PACKAGE_EHIP_TOOLS_ROUTE=y
CONFIG_PACKAGE_EHIP_TOOLS_TRACEROUTE=y
CONFIG_PACKAGE_EHIP_TOOLS_UDP_ECHO=y
CONFIG_PACKAGE_EHIP_TOOLS_TCP_ECHO=y
CONFIG_PACKAGE_EHSHELL=y
CONFIG_PACKAGE_EHSHELL_PASSWORD=""
CONFIG_PACKAGE_EHSHELL_ARGC_MAX=9
CONFIG_PACKAGE_EHSHELL_BUILTIN_SEGGER_RTT=y
CONFIG_PACKAGE_EHSHELL_BUILTIN_TELNET_SERVER=y
```
