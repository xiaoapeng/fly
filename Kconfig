## arch/mcxn947/Kconfig
```kconfig
if ARCH_MCXN947

config ARCH_HAS_TRUSTZONE
    bool
    default y

config ARCH_TRUSTZONE_MODE
    string
    default "non-secure"

config ARCH_TRUSTZONE_NON_SECURE
    bool
    default y

config ARCH_NVIC_PRIO_BITS
    int
    default 3

config ARCH_PROVIDES_SYSTICK_HANDLER
    bool
    default y

endif
```

## arch/quicklogic/eos-s3/Kconfig
```kconfig
if ARCH_QUICKLOGIC_EOS_S3

config ARCH_NVIC_PRIO_BITS
    int
    default 3

endif
```

## arch/silabs/efr32mg26/Kconfig
```kconfig
if ARCH_EFR32MG26

config ARCH_HAS_TRUSTZONE
    bool
    default y

config ARCH_TRUSTZONE_MODE
    string
    default "unified"

config ARCH_NVIC_PRIO_BITS
    int
    default 4

endif
```

## arch/stm32/stm32f4xx/Kconfig
```kconfig
if ARCH_STM32F4XX

config ARCH_HAS_TRUSTZONE
    bool
    default n

config ARCH_TRUSTZONE_MODE
    string
    default "non-secure"

config ARCH_TRUSTZONE_NON_SECURE
    bool
    default n

config ARCH_NVIC_PRIO_BITS
    int
    default 4

config ARCH_PROVIDES_SYSTICK_HANDLER
    bool
    default n

endif
```

## templates/apps/freertos-nanosig/defconfig
```kconfig
CONFIG_PACKAGE_SCHEDULER_FREERTOS=y
CONFIG_PACKAGE_FREERTOS_TOTAL_HEAP_SIZE=32768
CONFIG_PACKAGE_FREERTOS_SYSTICK_CLOCK_HZ=@BOARD_CLOCK_HZ@
CONFIG_PACKAGE_NANOSIG=y
```

## templates/scaffold/Kconfig
```kconfig
mainmenu "FLY Project Configuration"

source "$(FLY_SDK_DIR)/arch/Kconfig"
source "$(FLY_SDK_DIR)/package/Kconfig"
```
