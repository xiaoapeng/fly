## project/mcxn947/baremetal-demo/defconfig
```kconfig
CONFIG_ARCH_MCXN947=y
CONFIG_PROJECT_MCXN947_BAREMETAL_DEMO=y
CONFIG_PACKAGE_NSBTN=y
CONFIG_PACKAGE_NANOSIG=y
CONFIG_PACKAGE_SCHEDULER_NONE=y
CONFIG_PACKAGE_LWBTN_USE_CLICK=y
```

## project/mcxn947/freertos-demo/Kconfig
```kconfig
choice FLY_PROJECT_MCXN947
    depends on ARCH_MCXN947

config PROJECT_MCXN947_FREERTOS_DEMO
    bool "MCXN947 freertos demo project (FreeRTOS 2-task)"
    help
        Self-contained demo: 2 FreeRTOS tasks (RTT tick + LED), SysTick owned
        by FreeRTOS. Selects PACKAGE_SCHEDULER_REQUIRE_FREERTOS so the
        scheduler choice defaults to the FreeRTOS leg (a plain choice pin
        cannot be selected from here — no-op on choice symbols).
        Applies -Wno-conversion only to the freertos-kernel/heap/port targets.
    select PACKAGE_SCHEDULER_REQUIRE_FREERTOS
    select PACKAGE_SEGGER_RTT

endchoice

config PROJECT
    string
    default "mcxn947/freertos-demo" if PROJECT_MCXN947_FREERTOS_DEMO
```

## project/mcxn947/freertos-demo/defconfig
```kconfig
CONFIG_PROJECT_MCXN947_FREERTOS_DEMO=y
CONFIG_PACKAGE_NANOSIG=y
CONFIG_PACKAGE_SCHEDULER_FREERTOS=y
CONFIG_PACKAGE_FREERTOS_TOTAL_HEAP_SIZE=32768
CONFIG_PACKAGE_FREERTOS_SYSTICK_CLOCK_HZ=150000000
```

## project/mcxn947/mcxn947-demo/Kconfig
```kconfig
choice FLY_PROJECT_MCXN947
    depends on ARCH_MCXN947

config PROJECT_MCXN947_DEMO
    bool "MCXN947 demo project"
    help
        Select this option to enable Module MCXN947 DEMO.
    select PACKAGE_SCHEDULER_REQUIRE_EVENTHUB_OS
    select PACKAGE_SEGGER_RTT

endchoice

config PROJECT
    string
    default "mcxn947/mcxn947-demo" if PROJECT_MCXN947_DEMO
```

## project/mcxn947/mcxn947-eth-demo/Kconfig
```kconfig
choice FLY_PROJECT_MCXN947
    depends on ARCH_MCXN947

config PROJECT_MCXN947_ETH_DEMO
    bool "MCXN947 eth demo project"
    help
        Select this option to enable Module MCXN947 eth DEMO.
    select PACKAGE_SCHEDULER_REQUIRE_EVENTHUB_OS
    select PACKAGE_SEGGER_RTT
    select PACKAGE_EHIP

endchoice

config PROJECT
    string
    default "mcxn947/mcxn947-eth-demo" if PROJECT_MCXN947_ETH_DEMO
```

## project/stm32f0xx/Kconfig
```kconfig
choice FLY_PROJECT_STM32F0XX
    prompt "Select a stm32f0xx platform project"
    default PROJECT_STM32F0XX_NONE
    depends on ARCH_STM32F0XX

config PROJECT_STM32F0XX_NONE
    bool "None"
    help
      Select this if you do not want to set any project.

endchoice

rsource "*/Kconfig"
```

## project/stm32f0xx/stm32f030x8-demo/Kconfig
```kconfig
choice FLY_PROJECT_STM32F0XX
    depends on ARCH_STM32F0XX

config PROJECT_STM32F030X8_DEMO
    bool "STM32F030X8 demo project"
    help
        Select this option to enable Module STM32F030X8 DEMO.
    select PACKAGE_SCHEDULER_REQUIRE_EVENTHUB_OS
    select PACKAGE_SEGGER_RTT

endchoice

config PROJECT
    string
    default "stm32f0xx/stm32f030x8-demo" if PROJECT_STM32F030X8_DEMO
```

## project/stm32f1xx/Kconfig
```kconfig
choice FLY_PROJECT_STM32F1XX
    prompt "Select a stm32f1xx platform project"
    default PROJECT_STM32F1XX_NONE
    depends on ARCH_STM32F1XX

config PROJECT_STM32F1XX_NONE
    bool "None"
    help
      Select this if you do not want to set any project.

endchoice

rsource "*/Kconfig"
```

## project/stm32f1xx/stm32f103c6-demo/Kconfig
```kconfig
choice FLY_PROJECT_STM32F1XX
    depends on ARCH_STM32F1XX

config PROJECT_STM32F103C6_DEMO
    bool "STM32F103C6 demo project"
    help
        Select this option to enable Module STM32F103C6 DEMO.
    select PACKAGE_SCHEDULER_REQUIRE_EVENTHUB_OS
    select PACKAGE_SEGGER_RTT

endchoice

config PROJECT
    string
    default "stm32f1xx/stm32f103c6-demo" if PROJECT_STM32F103C6_DEMO
```

## project/stm32f1xx/stm32f103c6-demo/defconfig
```kconfig
CONFIG_ARCH_STM32F1XX=y
CONFIG_PROJECT_STM32F103C6_DEMO=y
CONFIG_PACKAGE_SCHEDULER_EVENTHUB_OS=y
```

## project/stm32f4xx/Kconfig
```kconfig
choice FLY_PROJECT_STM32F4XX
    prompt "Select a stm32f4xx platform project"
    default PROJECT_STM32F4XX_NONE
    depends on ARCH_STM32F4XX

config PROJECT_STM32F4XX_NONE
    bool "None"
    help
      Select this if you do not want to set any project.

endchoice

rsource "*/Kconfig"
```

## project/stm32f4xx/stm32f401cb-demo/Kconfig
```kconfig
choice FLY_PROJECT_STM32F4XX
    depends on ARCH_STM32F4XX

config PROJECT_STM32F401CB_DEMO
    bool "STM32F401CB demo project"
    help
        Select this option to enable Module STM32F401CB DEMO.
    select PACKAGE_SCHEDULER_REQUIRE_EVENTHUB_OS
    select PACKAGE_SEGGER_RTT

endchoice

config PROJECT
    string
    default "stm32f4xx/stm32f401cb-demo" if PROJECT_STM32F401CB_DEMO
```

## project/stm32f4xx/stm32f401cb-demo/defconfig
```kconfig
CONFIG_ARCH_STM32F4XX=y
CONFIG_PROJECT_STM32F401CB_DEMO=y
CONFIG_PACKAGE_SCHEDULER_EVENTHUB_OS=y
```

## project/stm32h7xx/Kconfig
```kconfig
choice FLY_PROJECT_STM32H7XX
    prompt "Select a stm32h7xx platform project"
    default PROJECT_STM32H7XX_NONE
    depends on ARCH_STM32H7XX

config PROJECT_STM32H7XX_NONE
    bool "None"
    help
      Select this if you do not want to set any project.

endchoice

rsource "*/Kconfig"
```

## project/windows/Kconfig
```kconfig
choice FLY_PROJECT_WINDOWS
    prompt "Select a windows platform project"
    default PROJECT_WINDOWS_NONE
    depends on ARCH_X64_WINDOWS

config PROJECT_WINDOWS_NONE
    bool "None"
    help
      Select this if you do not want to set any project.

endchoice

rsource "*/Kconfig"
```

## project/windows/co-ctx-test/Kconfig
```kconfig
choice FLY_PROJECT_WINDOWS
    depends on ARCH_X64_WINDOWS

config PROJECT_WINDOWS_CO_CTX_TEST
    bool "Coroutine context save/restore test"
    help
        Select this option to test coroutine context save/restore on x64.
    select PACKAGE_SCHEDULER_REQUIRE_EVENTHUB_OS

endchoice

config PROJECT
    string
    default "windows/co-ctx-test" if PROJECT_WINDOWS_CO_CTX_TEST
```

## project/windows/co-ctx-test/defconfig
```kconfig
CONFIG_ARCH_X64_WINDOWS=y
CONFIG_PROJECT_WINDOWS_CO_CTX_TEST=y
CONFIG_PACKAGE_SCHEDULER_EVENTHUB_OS=y
```

## project/windows/ehip-test/Kconfig
```kconfig
choice FLY_PROJECT_WINDOWS
    depends on ARCH_X64_WINDOWS

config PROJECT_WINDOWS_EHIP_TEST
    bool "EHIP test project"
    help
        Select this option to enable Module EHIP TEST.
    select PACKAGE_SCHEDULER_REQUIRE_EVENTHUB_OS
    select PACKAGE_EHIP
    select PACKAGE_EHSHELL
    select PACKAGE_ARGUMENT_PARSER

endchoice

config PROJECT
    string
    default "windows/ehip-test" if PROJECT_WINDOWS_EHIP_TEST
```
