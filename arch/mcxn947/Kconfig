## project/macos/Kconfig
```kconfig
choice FLY_PROJECT_MACOS
    prompt "Select a macos platform project"
    default PROJECT_MACOS_NONE
    depends on ARCH_ARM64_MACOS

config PROJECT_MACOS_NONE
    bool "None"
    help
      Select this if you do not want to set any project.

endchoice

rsource "*/Kconfig"
```

## project/macos/ehip-test/Kconfig
```kconfig
choice FLY_PROJECT_MACOS
    depends on ARCH_ARM64_MACOS

config PROJECT_MACOS_EHIP_TEST
    bool "EHIP test project"
    help
        Select this option to enable Module EHIP TEST.
    select PACKAGE_SCHEDULER_REQUIRE_EVENTHUB_OS
    select PACKAGE_EHIP
    select PACKAGE_EHSHELL
    select PACKAGE_ARGUMENT_PARSER

endchoice

config PROJECT
    string
    default "macos/ehip-test" if PROJECT_MACOS_EHIP_TEST
```

## project/mcxn947/Kconfig
```kconfig
choice FLY_PROJECT_MCXN947
    prompt "Select a mcxn947 platform project"
    default PROJECT_MCXN947_NONE
    depends on ARCH_MCXN947

config PROJECT_MCXN947_NONE
    bool "None"
    help
      Select this if you do not want to set any project.

endchoice

rsource "*/Kconfig"
```

## project/mcxn947/baremetal-demo/Kconfig
```kconfig
choice FLY_PROJECT_MCXN947
    depends on ARCH_MCXN947

config PROJECT_MCXN947_BAREMETAL_DEMO
    bool "MCXN947 bare-metal button and RGB LED demo"
    help
        Same button and RGB LED behavior as freertos-demo, driven by a
        nanosig polling loop without an RTOS. SysTick supplies a 1 ms clock.
        Use the baremetal-demo defconfig to select the None scheduler model.
    select PACKAGE_SEGGER_RTT

endchoice

config PROJECT
    string
    default "mcxn947/baremetal-demo" if PROJECT_MCXN947_BAREMETAL_DEMO
```
