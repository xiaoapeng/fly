## arch/mcxn947/Kconfig
```kconfig
if ARCH_MCXN947

config ARCH_CPU_FAMILY_CORTEX_M
    bool
    default y

config ARCH_CORE
    string
    default "cortex-m33"

config ARCH_HAS_HARD_FPU
    bool
    default y

config ARCH_FLOAT_ABI
    string
    default "hard"

config ARCH_HAS_TRUSTZONE
    bool
    default y

config ARCH_TRUSTZONE_MODE
    string
    default "non-secure"

config ARCH_TRUSTZONE_NON_SECURE
    bool
    default y

config ARCH_NVIC_PRIO_BITS
    int
    default 3

config ARCH_PROVIDES_SYSTICK_HANDLER
    bool
    default y

endif
```

## arch/stm32/stm32f0xx/Kconfig
```kconfig
if ARCH_STM32F0XX

config ARCH_CPU_FAMILY_CORTEX_M
    bool
    default y

config ARCH_CORE
    string
    default "cortex-m0"

config ARCH_HAS_HARD_FPU
    bool
    default n

config ARCH_FLOAT_ABI
    string
    default "soft"

config ARCH_HAS_TRUSTZONE
    bool
    default n

config ARCH_TRUSTZONE_MODE
    string
    default "non-secure"

config ARCH_TRUSTZONE_NON_SECURE
    bool
    default n

config ARCH_NVIC_PRIO_BITS
    int
    default 2

config ARCH_PROVIDES_SYSTICK_HANDLER
    bool
    default y

endif
```

## arch/stm32/stm32f4xx/Kconfig
```kconfig
if ARCH_STM32F4XX

config ARCH_CPU_FAMILY_CORTEX_M
    bool
    default y

config ARCH_CORE
    string
    default "cortex-m4"

config ARCH_HAS_HARD_FPU
    bool
    default y

config ARCH_FLOAT_ABI
    string
    default "hard"

config ARCH_HAS_TRUSTZONE
    bool
    default n

config ARCH_TRUSTZONE_MODE
    string
    default "non-secure"

config ARCH_TRUSTZONE_NON_SECURE
    bool
    default n

config ARCH_NVIC_PRIO_BITS
    int
    default 4

config ARCH_PROVIDES_SYSTICK_HANDLER
    bool
    default n

endif
```

## package/lwbtn/Kconfig
```kconfig
menu "lwbtn"

config PACKAGE_LWBTN
    bool "Enable lwbtn button manager"
    default n
    help
        Lightweight button manager (github.com/MaJerle/lwbtn).
        Polling-based: the application calls lwbtn_process(now_ms)
        periodically and receives ONPRESS / ONRELEASE / ONCLICK /
        KEEPALIVE events through a single callback.
        The FLY integration compiles the upstream single source file
        directly and maps the options below onto LWBTN_CFG_* macros.

config PACKAGE_LWBTN_GIT_COMMIT
    string "lwbtn pinned commit"
    default "92307ea7693d4174cd9aa4537664a712cd03e0c6"
    depends on PACKAGE_LWBTN
    help
        Full 40-hex commit SHA fetched from
        https://github.com/MaJerle/lwbtn.git (develop HEAD, header
        version v1.3.2). No local patches are applied.

config PACKAGE_LWBTN_USE_KEEPALIVE
    bool "Keepalive events while button is active"
    default y
    depends on PACKAGE_LWBTN
    help
        Maps to LWBTN_CFG_USE_KEEPALIVE. Disabling it removes the
        keepalive state machine, the LWBTN_EVT_KEEPALIVE enum value and
        the related fields from struct lwbtn_btn.

config PACKAGE_LWBTN_USE_CLICK
    bool "Click / multi-click detection"
    default y
    depends on PACKAGE_LWBTN
    help
        Maps to LWBTN_CFG_USE_CLICK. Disabling it removes the click state
        machine, the LWBTN_EVT_ONCLICK enum value and the related fields
        from struct lwbtn_btn.

config PACKAGE_LWBTN_DEBOUNCE_PRESS_MS
    int "Press debounce time (ms)"
    range 0 10000
    default 20
    depends on PACKAGE_LWBTN
    help
        Maps to LWBTN_CFG_TIME_DEBOUNCE_PRESS.

config PACKAGE_LWBTN_DEBOUNCE_RELEASE_MS
    int "Release debounce time (ms)"
    range 0 10000
    default 0
    depends on PACKAGE_LWBTN
    help
        Maps to LWBTN_CFG_TIME_DEBOUNCE_RELEASE. Upstream default is 0
        (release is accepted immediately).

config PACKAGE_LWBTN_KEEPALIVE_PERIOD_MS
    int "Keepalive period while active (ms)"
    range 1 60000
    default 100
    depends on PACKAGE_LWBTN && PACKAGE_LWBTN_USE_KEEPALIVE
    help
        Maps to LWBTN_CFG_TIME_KEEPALIVE_PERIOD. Upstream default is
        100 ms.

config PACKAGE_LWBTN_CLICK_MIN_MS
    int "Minimum press time for a click (ms)"
    range 0 60000
    default 20
    depends on PACKAGE_LWBTN && PACKAGE_LWBTN_USE_CLICK
    help
        Maps to LWBTN_CFG_TIME_CLICK_MIN.

config PACKAGE_LWBTN_CLICK_MAX_MS
    int "Maximum press time for a click (ms)"
    range 0 60000
    default 300
    depends on PACKAGE_LWBTN && PACKAGE_LWBTN_USE_CLICK
    help
        Maps to LWBTN_CFG_TIME_CLICK_MAX.

config PACKAGE_LWBTN_CLICK_MULTI_MAX_MS
    int "Multi-click window (ms)"
    range 0 60000
    default 400
    depends on PACKAGE_LWBTN && PACKAGE_LWBTN_USE_CLICK
    help
        Maps to LWBTN_CFG_TIME_CLICK_MULTI_MAX.

config PACKAGE_LWBTN_CLICK_MAX_CONSECUTIVE
    int "Maximum consecutive clicks"
    range 1 255
    default 3
    depends on PACKAGE_LWBTN && PACKAGE_LWBTN_USE_CLICK
    help
        Maps to LWBTN_CFG_CLICK_MAX_CONSECUTIVE. Upstream stores this in
        a uint8_t, so the range is capped at 255.

config PACKAGE_LWBTN_CLICK_SEND_IMMEDIATELY
    bool "Send click immediately when max consecutive is reached"
    default y
    depends on PACKAGE_LWBTN && PACKAGE_LWBTN_USE_CLICK
    help
        Maps to LWBTN_CFG_CLICK_MAX_CONSECUTIVE_SEND_IMMEDIATELY.

config PACKAGE_LWBTN_CLICK_KEEP_AFTER_SHORT_PRESS
    bool "Keep click counter after a short press"
    default n
    depends on PACKAGE_LWBTN && PACKAGE_LWBTN_USE_CLICK
    help
        Maps to LWBTN_CFG_CLICK_CONSECUTIVE_KEEP_AFTER_SHORT_PRESS.

endmenu
```

## package/nanosig/Kconfig
```kconfig
menu "nanosig"

config PACKAGE_NANOSIG
    bool "Enable nanosig signal/slot library"
    default n
    help
        C11 signal/slot library (github.com/xiaoapeng/nanosig).
        Provides signal connect/emit with a caller-owned, zero-allocation
        hot path. The FLY integration compiles the upstream sources
        directly, selecting the upstream FreeRTOS platform backend
        (NANOSIG_PLATFORM=freertos) with no local patches.

config PACKAGE_NANOSIG_GIT_COMMIT
    string "nanosig pinned commit"
    default "9abd957a2ca23512c1f093cb1f0f15a99bd3671f"
    depends on PACKAGE_NANOSIG
    help
        Full 40-hex commit SHA fetched from
        https://github.com/xiaoapeng/nanosig.git. This pin carries the
        upstream FreeRTOS platform backend; no local patches are applied.

choice PACKAGE_NANOSIG_LOG_LEVEL
    prompt "nanosig debug output level"
    default PACKAGE_NANOSIG_LOG_LEVEL_SYS
    depends on PACKAGE_NANOSIG
    help
        Compile-time default for nanosig's global debug level
        (NS_CONFIG_DEFAULT_DEBUG_LEVEL). It gates the runtime output of
        every ns_dbg_* / ns_m* log macro that survived its module-level
        compile check. ERR/WARN/SYS are the useful production levels;
        INFO/DEBUG are verbose. Can still be overridden at runtime with
        ns_dbg_set_level().

    config PACKAGE_NANOSIG_LOG_LEVEL_SUPPRESS
        bool "Suppress (0)"
    config PACKAGE_NANOSIG_LOG_LEVEL_ERR
        bool "Error (1)"
    config PACKAGE_NANOSIG_LOG_LEVEL_WARNING
        bool "Warning (2)"
    config PACKAGE_NANOSIG_LOG_LEVEL_SYS
        bool "System (3)"
    config PACKAGE_NANOSIG_LOG_LEVEL_INFO
        bool "Info (4)"
    config PACKAGE_NANOSIG_LOG_LEVEL_DEBUG
        bool "Debug (5)"
endchoice

config PACKAGE_NANOSIG_LOG_LEVEL
    int
    default 0 if PACKAGE_NANOSIG_LOG_LEVEL_SUPPRESS
    default 1 if PACKAGE_NANOSIG_LOG_LEVEL_ERR
    default 2 if PACKAGE_NANOSIG_LOG_LEVEL_WARNING
    default 3 if PACKAGE_NANOSIG_LOG_LEVEL_SYS
    default 4 if PACKAGE_NANOSIG_LOG_LEVEL_INFO
    default 5 if PACKAGE_NANOSIG_LOG_LEVEL_DEBUG

endmenu
```

## package/nsbtn/Kconfig
```kconfig
menu "nsbtn"

config PACKAGE_NSBTN
    bool "Enable nsbtn (lwbtn button wrapper with nanosig signals)"
    default n
    depends on PACKAGE_NANOSIG
    select PACKAGE_LWBTN
    help
        Wraps the lwbtn button manager and publishes button events as one
        global nanosig signal (`nsbtn_event`). All registered buttons share
        a single lwbtn instance; the caller injects a nanosig loop at
        nsbtn_init() and the package drives lwbtn polling from a periodic
        ns_timer on that loop.

        Call order is a hard contract: init -> register... -> scan_start ->
        (events) -> scan_stop -> deinit. Register is legal only while
        scanning is stopped, which is what replaces locking. There is no
        unregister: handles stay valid until deinit.

        Depends on nanosig (we do not select it: the loop backend and
        scheduler choice stay the project's decision) and pulls in lwbtn.

config PACKAGE_NSBTN_MAX_BUTTONS
    int "Maximum registered buttons"
    range 1 32
    default 8
    depends on PACKAGE_NSBTN
    help
        Size of the static button pool. nsbtn_register() returns NULL once
        the pool is full. There is no unregister; deinit resets the pool.

config PACKAGE_NSBTN_SCAN_PERIOD_MS
    int "Button scan period (ms)"
    range 1 100
    default 10
    depends on PACKAGE_NSBTN
    help
        Period of the poll timer that calls lwbtn_process_ex(). Matches the
        previous application-level glue default (10 ms).

endmenu
```

## package/scheduler/freertos/Kconfig
```kconfig
# FreeRTOS sub-config. The scheduler choice PACKAGE_SCHEDULER_FREERTOS
# is the user-facing entry point; this file only contributes the tunables
# under that choice and is pulled in by package/scheduler/Kconfig::rsource.

if PACKAGE_SCHEDULER_FREERTOS

choice PACKAGE_FREERTOS_VERSION
    prompt "FreeRTOS-Kernel version"
    default PACKAGE_FREERTOS_VERSION_V11100
    help
      Select the FreeRTOS-Kernel source version. The available versions
      are the versions supported by this FLY integration.

    config PACKAGE_FREERTOS_VERSION_V11100
        bool "V11.1.0 (default)"
endchoice

config PACKAGE_FREERTOS_GIT_TAG
    string
    default "V11.1.0" if PACKAGE_FREERTOS_VERSION_V11100

choice PACKAGE_FREERTOS_HEAP
    prompt "Memory allocator (portable/MemMang)"
    default PACKAGE_FREERTOS_HEAP_HEAP4
    config PACKAGE_FREERTOS_HEAP_HEAP1
        bool "heap_1.c (no free)"
    config PACKAGE_FREERTOS_HEAP_HEAP2
        bool "heap_2.c"
    config PACKAGE_FREERTOS_HEAP_HEAP3
        bool "heap_3.c (wraps newlib malloc)"
    config PACKAGE_FREERTOS_HEAP_HEAP4
        bool "heap_4.c (coalescing, default)"
    config PACKAGE_FREERTOS_HEAP_HEAP5
        bool "heap_5.c (multiple regions)"
endchoice

config PACKAGE_FREERTOS_TICK_RATE_HZ
    int "Tick rate (Hz)"
    default 1000

config PACKAGE_FREERTOS_MAX_PRIORITIES
    int "Number of task priorities"
    default 5

config PACKAGE_FREERTOS_TOTAL_HEAP_SIZE
    int "Total heap size (bytes)"
    default 8192

config PACKAGE_FREERTOS_MINIMAL_STACK_SIZE
    int "Minimal task stack size (words)"
    default 128

config PACKAGE_FREERTOS_SYSTICK_CLOCK_HZ
    int "SysTick clock (Hz)"
    default 120000000
    help
      Core clock frequency feeding the SysTick timer. It MUST match the
      board's SystemCoreClock from the project's clock_config.c — a
      mismatch scales all vTaskDelay/timeout values by the same ratio
      (e.g. 120 MHz configured on a 150 MHz board makes a 500 ms delay
      run in 400 ms). Pin this in the project defconfig; the 120 MHz
      default is only a placeholder.

config PACKAGE_FREERTOS_USE_TIMERS
    bool "Software timers (timers.c)"
    default n
    help
      When enabled, FreeRTOS software timer APIs are available. Changing
      this option changes the compiled source files and triggers reconfiguration.

config PACKAGE_FREERTOS_CHECK_STACK_OVERFLOW
    int "Stack overflow check level (0/1/2)"
    default 2

config PACKAGE_FREERTOS_TICKLESS_IDLE
    bool "Tickless idle (low-power mode)"
    default n
    help
      Tickless idle is not currently implemented by the selected FreeRTOS port.
      Leave this disabled; enabling it will not provide low-power tick suppression.

endif # PACKAGE_SCHEDULER_FREERTOS
```

## project/ch58x/Kconfig
```kconfig
choice FLY_PROJECT_CH58X
    prompt "Select a ch58x platform project"
    default PROJECT_CH58X_NONE
    depends on ARCH_CH58X

config PROJECT_CH58X_NONE
    bool "None"
    help
      Select this if you do not want to set any project.

endchoice

rsource "*/Kconfig"
```

## project/ch58x/ch582-demo/Kconfig
```kconfig
choice FLY_PROJECT_CH58X
    depends on ARCH_CH58X

config PROJECT_CH582_DEMO
    bool "CH582 demo project"
    help
        Select this option to enable Module CH582 DEMO.
    #select PACKAGE_SCHEDULER_EVENTHUB_OS
    select PACKAGE_SEGGER_RTT

endchoice

config PROJECT
    string
    default "ch58x/ch582-demo" if PROJECT_CH582_DEMO
```

## project/gd32e23x/Kconfig
```kconfig
choice FLY_PROJECT_GD32E23X
    prompt "Select a gd32e23x platform project"
    default PROJECT_GD32E23X_NONE
    depends on ARCH_GD32E23X

config PROJECT_GD32E23X_NONE
    bool "None"
    help
      Select this if you do not want to set any project.

endchoice

rsource "*/Kconfig"
```

## project/gd32e23x/gd32e230-demo/Kconfig
```kconfig
choice FLY_PROJECT_GD32E23X
    depends on ARCH_GD32E23X

config PROJECT_GD32E230_DEMO
    bool "GD32E230 demo project"
    help
        Select this option to enable Module GD32E230 DEMO.
    select PACKAGE_SEGGER_RTT

endchoice

config PROJECT
    string
    default "gd32e23x/gd32e230-demo" if PROJECT_GD32E230_DEMO
```

## project/gd32f10x/Kconfig
```kconfig
choice FLY_PROJECT_GD32F10X
    prompt "Select a gd32f10x platform project"
    default PROJECT_GD32F10X_NONE
    depends on ARCH_GD32F10X

config PROJECT_GD32F10X_NONE
    bool "None"
    help
      Select this if you do not want to set any project.

endchoice

rsource "*/Kconfig"
```

## project/gd32f10x/gd32f103-demo/Kconfig
```kconfig
choice FLY_PROJECT_GD32F10X
    depends on ARCH_GD32F10X

config PROJECT_GD32F103_DEMO
    bool "GD32F103 demo project"
    help
        Select this option to enable Module GD32F103 DEMO.

endchoice

config PROJECT
    string
    default "gd32f10x/gd32f103-demo" if PROJECT_GD32F103_DEMO
```

## project/gd32f10x/gd32f105-demo/Kconfig
```kconfig
choice FLY_PROJECT_GD32F10X
    depends on ARCH_GD32F10X

config PROJECT_GD32F105_DEMO
    bool "GD32F105 demo project"
    help
        Select this option to enable Module GD32F105 DEMO.
    select PACKAGE_SCHEDULER_REQUIRE_EVENTHUB_OS
    select PACKAGE_SEGGER_RTT

endchoice

config PROJECT
    string
    default "gd32f10x/gd32f105-demo" if PROJECT_GD32F105_DEMO
```

## project/gd32vf103x/Kconfig
```kconfig
choice FLY_PROJECT_GD32VF103X
    prompt "Select a gd32vf103x platform project"
    default PROJECT_GD32VF103X_NONE
    depends on ARCH_GD32VF103X

config PROJECT_GD32VF103X_NONE
    bool "None"
    help
      Select this if you do not want to set any project.

endchoice

rsource "*/Kconfig"
```

## project/gd32vf103x/gd32vf103c-demo/Kconfig
```kconfig
choice FLY_PROJECT_GD32VF103X
    depends on ARCH_GD32VF103X

config PROJECT_GD32VF103C_DEMO
    bool "GD32VF103C demo project"
    help
        Select this option to enable Module GD32VF103C DEMO.
    select PACKAGE_SCHEDULER_REQUIRE_EVENTHUB_OS
    select PACKAGE_SEGGER_RTT

endchoice

config PROJECT
    string
    default "gd32vf103x/gd32vf103c-demo" if PROJECT_GD32VF103C_DEMO
```

## project/linux/Kconfig
```kconfig
choice FLY_PROJECT_LINUX
    prompt "Select a linux platform project"
    default PROJECT_LINUX_NONE
    depends on ARCH_X64_LINUX

config PROJECT_LINUX_NONE
    bool "None"
    help
      Select this if you do not want to set any project.

endchoice

rsource "*/Kconfig"
```

## project/linux/ehip-test/Kconfig
```kconfig
choice FLY_PROJECT_LINUX
    depends on ARCH_X64_LINUX

config PROJECT_EHIP_TEST
    bool "EHIP test project"
    help
        Select this option to enable Module EHIP TEST.
    select PACKAGE_SCHEDULER_REQUIRE_EVENTHUB_OS
    select PACKAGE_EHIP
    select PACKAGE_EHSHELL
    select PACKAGE_ARGUMENT_PARSER

endchoice

config PROJECT
    string
    default "linux/ehip-test" if PROJECT_EHIP_TEST
```
